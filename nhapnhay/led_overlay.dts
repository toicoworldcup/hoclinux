/dts-v1/;
/plugin/;

/ {
    fragment@0 {
        target-path = "/";
        __overlay__ {
            hieu_led_node {
                label = "hieu_led_device";
                gpios = <&gpio 23 0>,<&gpio 24 0>;//red and blue

                status = "okay";
            };
        };
    };
};